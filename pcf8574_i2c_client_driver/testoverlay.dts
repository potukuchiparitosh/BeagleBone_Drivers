/dts-v1/;
/plugin/;
/ {
	compatible = "ti,beaglebone","ti,beaglebone-black";

	fragment@0 {
		target = <&i2c2>;
		__overlay__ {
            #address-cells = <1>;
            #size-cells = <0>;

			my_adc:my_adc@10 {
				compatible = "expander,i2cgpio";
				status = "okay";
                    reg = <0x27>;

			};
		};
	};
};
